# file: FCS_PID_Controller.ioc
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Mcu.Family=STM32F0
Mcu.Name=STM32F051R8Tx
Mcu.Package=LQFP64
ProjectManager.HeapSize=0x200
ProjectManager.StackSize=0x400
ProjectManager.TargetToolchain=STM32CubeIDE
board=custom

// file: Core/Src/main.c
/* USER CODE BEGIN Header */
/**
  ******************************************************************************
  * @file           : main.c
  * @brief          : Main program body
  ******************************************************************************
  * @attention
  *
  * Copyright (c) 2022 STMicroelectronics.
  * All rights reserved.
  *
  * This software is licensed under terms that can be found in the LICENSE file
  * in the root directory of this software component.
  * If no LICENSE file comes with this software, it is provided AS-IS.
  *
  ******************************************************************************
  */
/* USER CODE END Header */
#include "main.h"

void SystemClock_Config(void);
/* USER CODE BEGIN PFP */
void myPID(int16_t);
void executePID(int16_t*, float*, float*, float*, float*, float*, float*);
void controlServo(float*);
/* USER CODE END PFP */

int main(void)
{

  /* MCU Configuration--------------------------------------------------------*/

  /* Reset of all peripherals, Initializes the Flash interface and the Systick. */
  HAL_Init();

  /* Configure the system clock */
  SystemClock_Config();

  /* Initialize all configured peripherals */

  /* Infinite loop */
  while (1)
  {
		myPID(100);
  }
}

void myPID(int16_t desired_speed)
{
	desired_speed=0;
	int16_t error=0, prev_error=0;
	float kP=0, kI=0, kD=0;
	float integral=0, derivative=0;
	int16_t measured_speed=0;
	float power=0;
	int16_t huge_value=0;
	uint32_t time_elapsed, delay_time;
	delay_time = HAL_GetTick() + 20;

	while(1)
	{
		time_elapsed = HAL_GetTick();
		if(time_elapsed >= delay_time)
		{
			error = desired_speed-measured_speed;
			integral += error;
			if(error == 0 || error == desired_speed || error == huge_value)
			{
				integral = 0;
			}

			derivative = error - prev_error;
			prev_error = error;
			executePID(&error, &kP, &kI, &kD, &integral, &derivative, &power);
			controlServo(&power);
			time_elapsed = HAL_GetTick();
		}
	}
}

void executePID(int16_t* error_value, float* p_value, float* i_value, float* d_value, float* integral_val, float* derivative_val, float* power_val)
{
	*power_val=(*error_value)*(*p_value) + (*integral_val)*(*i_value) + (*derivative_val)*(*d_value);
}
void controlServo(float* ctrl_val){}

void SystemClock_Config(void)
{
  RCC_OscInitTypeDef RCC_OscInitStruct = {0};
  RCC_ClkInitTypeDef RCC_ClkInitStruct = {0};

  /** Initializes the RCC Oscillators according to the specified parameters
  * in the RCC_OscInitTypeDef structure.
  */
  RCC_OscInitStruct.OscillatorType = RCC_OSCILLATORTYPE_HSI;
  RCC_OscInitStruct.HSIState = RCC_HSI_ON;
  RCC_OscInitStruct.HSICalibrationValue = RCC_HSICALIBRATION_DEFAULT;
  RCC_OscInitStruct.PLL.PLLState = RCC_PLL_NONE;
  if (HAL_RCC_OscConfig(&RCC_OscInitStruct) != HAL_OK)
  {
    Error_Handler();
  }

  /** Initializes the CPU, AHB and APB buses clocks
  */
  RCC_ClkInitStruct.ClockType = RCC_CLOCKTYPE_HCLK|RCC_CLOCKTYPE_SYSCLK
                              |RCC_CLOCKTYPE_PCLK1;
  RCC_ClkInitStruct.SYSCLKSource = RCC_SYSCLKSOURCE_HSI;
  RCC_ClkInitStruct.AHBCLKDivider = RCC_SYSCLK_DIV1;
  RCC_ClkInitStruct.APB1CLKDivider = RCC_HCLK_DIV1;

  if (HAL_RCC_ClockConfig(&RCC_ClkInitStruct, FLASH_LATENCY_0) != HAL_OK)
  {
    Error_Handler();
  }
}

void Error_Handler(void)
{
  __disable_irq();
  while (1)
  {
  }
}
